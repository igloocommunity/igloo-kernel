## arch/arm/mach-ux500/Kconfig
```kconfig
if ARCH_U8500

config UX500_SOC_COMMON
	bool
	default y
	select ARM_GIC
	select HAS_MTU
	select PL310_ERRATA_753970
	select ARM_ERRATA_754322
	select ARM_ERRATA_764369
	select SYS_SOC

config UX500_SOC_DBX500
	depends on UX500_SOC_DB5500 || UX500_SOC_DB8500
	bool

menu "Ux500 SoC"

config UX500_SOC_DB5500
	bool "DB5500"
	select MFD_DB5500_PRCMU
	select UX500_SOC_DBX500

config UX500_SOC_DB8500
	bool "DB8500"
	select UX500_SOC_DBX500
	select MFD_DB8500_PRCMU
	select REGULATOR_DB8500_PRCMU

endmenu

menu "Ux500 target platform (boards)"

config MACH_U8500
	bool "U8500 Development platform"
	depends on UX500_SOC_DB8500
	select TPS6105X
	help
	  Include support for the mop500 development platform.

config MACH_HREFV60
       bool "U85000 Development platform, HREFv60 version"
       depends on UX500_SOC_DB8500
       help
         Include support for the HREFv60 new development platform.

config MACH_SNOWBALL
	bool "U8500 Snowball platform"
	depends on UX500_SOC_DB8500
	select MACH_U8500
	help
	  Include support for the snowball development platform.

config MACH_U5500
	bool "U5500 Development platform"
	depends on UX500_SOC_DB5500
	help
	  Include support for the U5500 development platform.
endmenu

choice
	prompt "Ux500 UIB Keylayout"
	default KEYLAYOUT_LAYOUT1

config KEYLAYOUT_LAYOUT1
	bool "UIB Keylayout 1; for generic users"
	help
	  Supported keylayout for some numerics, power/call buttons,
	  volume control etc

config KEYLAYOUT_LAYOUT2
	bool "UIB Keylayout 2; for connectivity users"
	help
	  Supports keylayout numerics 0-9, left/right/up/down/back/
	  enter keys and special character "."(dot)

endchoice

config UX500_DEBUG_UART
	int "Ux500 UART to use for low-level debug"
	default 2
	help
	  Choose the UART on which kernel low-level debug messages should be
	  output.

config U5500_MODEM_IRQ
	bool "Modem IRQ support"
	depends on UX500_SOC_DB5500
	default y
	help
	  Add support for handling IRQ:s from modem side

config U5500_MBOX
	bool "Mailbox support"
	depends on U5500_MODEM_IRQ
	default y
	help
	  Add support for U5500 mailbox communication with modem side

config UX500_DEBUG_NO_LAUTERBACH
       bool "Disable clocks needed for Lauterbach debugging"
       help
	  Disable clocks needed for Lauterbach debugging at boot.
	  If yes, you will reduce the power consumption.

config UX500_L2X0_PREFETCH_CTRL
	bool "PL310 prefetch control"
	depends on (UX500_SOC_DB8500 || UX500_SOC_DB5500) && \
			(TEE_UX500 && CACHE_L2X0)
	default y
	help
	  Adds interface to control instruction and data prefetch.
	  Communication with Trustzone is done through TEE driver.

source "arch/arm/mach-ux500/Kconfig-arch"
endif
```

## arch/arm/mach-ux500/pm/Kconfig
```kconfig
config DBX500_PRCMU_QOS_POWER
	bool "DBX500 PRCMU power QoS support"
	depends on (MFD_DB5500_PRCMU || MFD_DB8500_PRCMU)
	default y
	help
	  Add support for PRCMU power Quality of Service

config UX500_CONTEXT
	bool "Context save/restore support for UX500"
	depends on (UX500_SOC_DB8500 || UX500_SOC_DB5500) && PM
	help
	  This is needed for ApSleep and deeper sleep states.

config UX500_PM_PERFORMANCE
	bool "Performance supervision"
	depends on UX500_PRCMU_QOS_POWER
	default y
	help
	  Enable supervision of events which may require a boost
	  of platform performance.

config UX500_SUSPEND
	bool "Suspend to mem and standby support"
	depends on (UX500_SOC_DB8500 || UX500_SOC_DB5500) && PM && SUSPEND
	select UX500_CONTEXT
	help
	  Add support for suspend.

config UX500_SUSPEND_DBG
	bool "Suspend debug"
	depends on UX500_SUSPEND
	help
	  Add debug support for suspend.

config UX500_SUSPEND_DBG_WAKE_ON_UART
	bool "Suspend wakes on console UART"
	depends on UX500_SUSPEND_DBG
	help
	  Wake up on uart interrupts. Makes it possible for the console to wake up system.

config UX500_CONSOLE_UART_GPIO_PIN
	int "The pin number of the console UART GPIO pin"
	default 29
	depends on UX500_SUSPEND_DBG_WAKE_ON_UART
	help
	  GPIO pin number of the GPIO pin connected to the console UART RX line.
```

## drivers/clocksource/Kconfig
```kconfig
config CLKSRC_I8253
	bool

config CLKSRC_MMIO
	bool

config CLKSRC_DBX500_PRCMU
	bool "Clocksource PRCMU Timer"
	depends on UX500_SOC_DB5500 || UX500_SOC_DB8500
	default y
	help
	  Use the always on PRCMU Timer as clocksource

config CLKSRC_DBX500_PRCMU_SCHED_CLOCK
	bool "Clocksource PRCMU Timer sched_clock"
	depends on (CLKSRC_DBX500_PRCMU && !NOMADIK_MTU_SCHED_CLOCK)
	select HAVE_SCHED_CLOCK
	default y
	help
	  Use the always on PRCMU Timer as sched_clock
```

## drivers/cpuidle/Kconfig
```kconfig
config CPU_IDLE
	bool "CPU idle PM support"
	default ACPI
	depends on PM
	help
	  CPU idle is a generic framework for supporting software-controlled
	  idle processor power management.  It includes modular cross-platform
	  governors that can be swapped during runtime.

	  If you're using an ACPI-enabled platform, you should say Y here.

config CPU_IDLE_GOV_LADDER
	bool
	depends on CPU_IDLE
	default y

config CPU_IDLE_GOV_MENU
	bool
	depends on CPU_IDLE && NO_HZ
	default y

config UX500_CPUIDLE
	tristate "CPUIdle support"
	depends on CPU_IDLE && (MFD_DB5500_PRCMU || MFD_DB8500_PRCMU) && !RTC_DRV_PL031 && PM
	default y
	select GENERIC_CLOCKEVENTS_BROADCAST
	select UX500_CONTEXT
	help
	  Add support for CPUIdle for U8500.

config U8500_CPUIDLE_DEEPEST_STATE
	int "Deepest sleep state"
	default 4 if UX500_SOC_DB8500
	default 1 if UX500_SOC_DB5500
	depends on UX500_CPUIDLE
	help
	  Set deepest sleep state. See the cstate struct in cpuidle.c.
	  Default is ApSleep.

config U8500_CPUIDLE_APDEEPIDLE
	bool "CPUIdle ApDeepIdle"
	depends on U8500_CPUIDLE
	help
	  Adds the power level ApDeepIdle, where APE is powered on while
	  ARM is powered off. Default n.
```

## drivers/gpu/mali/Kconfig
```kconfig
config GPU_MALI
       tristate "ARM Mali 200/300/400 support"
       depends on ARM
       ---help---
       This enables support for the ARM Mali 200/300/400 family of GPUs.
       Platform specific configuration is made in configuration files in the
       drivers/gpu/mali/src folder
```
